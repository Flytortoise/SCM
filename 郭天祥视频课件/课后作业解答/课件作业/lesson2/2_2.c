/*******************************************************************/
/* TX-1C单片机实验板实验例程        							   */
/* 2007年8月第二期培训班课后习题详解							   */
/* 作者：郭天祥      											   */
/* 邮箱：txmcu@163.com 										  	   */
/* 网站：www.txmcu.com(天祥电子)    							   */
/*【版权】Copyright(C)天祥电子 www.txmcu.com  All Rights Reserved  */
/*【声明】此程序仅用于学习与参考，引用请注明版权和作者信息！       */
/*                                                                 */
/*******************************************************************/
                                                           
// 8个发光管由上至下间隔1s流动
//，其中每个管亮500ms,灭500ms,亮时蜂鸣器响
//，灭时关闭蜂鸣器，一直重复下去。
// 适用 TX-1C单片机实验板
// 晶振为11.0592M

/*********************************************************/
#include<reg52.h>  //52单片机头文件
#include <intrins.h> //包含有左右循环移位子函数的库
#define uint unsigned int    //宏定义
#define uchar unsigned char  //宏定义
sbit beep=P2^3;
void delay(uint z)  //延时函数,z的取值为这个函数的延时ms数，如delay(200);大约延时200ms.
{					//delay(500);大约延时500ms.
	uint x,y;
	for(x=z;x>0;x--)
		for(y=110;y>0;y--);	
}
void main()		    //主函数
{
	uchar a;
	a=0xfe;
	while(1)        //大循环
	{
		P1=a;       //点亮小灯
		beep=0;     //开启蜂鸣器
		delay(500); //延时500毫秒
		P1=0xff;    //熄灭小灯
		beep=1;     //关闭蜂鸣器
		delay(500); //延时500毫秒
		a=_crol_(a,1); //将a变量循环左移一位		
	}
}

